## meta-drive-sim/conf/distro/virtualdrive.conf
```bitbake
DISTRO = "virtualdrive"
DISTRO_NAME = "VirtualDrive Industrial OS"
DISTRO_VERSION = "1.0"
DISTRO_CODENAME = "scarthgap"

SDK_VENDOR = "-virtualdrivesdk"
SDK_VERSION = "${DISTRO_VERSION}"
SDK_NAME = "${DISTRO}-${TCLIBC}-${SDKMACHINE}-${IMAGE_BASENAME}-${TUNE_PKGARCH}"
SDKPATHINSTALL = "/opt/${DISTRO}/${SDK_VERSION}"

DISTRO_FEATURES ?= "acl argp ext2 ipv4 ipv6 largefile pam usbgadget \
                    usbhost wifi xattr nfs zeroconf pci vfat \
                    alsa bluetooth systemd"

DISTRO_FEATURES_BACKFILL_CONSIDERED = "sysvinit"
VIRTUAL-RUNTIME_init_manager = "systemd"
VIRTUAL-RUNTIME_initscripts = "systemd-compat-units"
VIRTUAL-RUNTIME_login_manager = "shadow-base"
VIRTUAL-RUNTIME_dev_manager = "udev"

# Inherit from poky base distro
require conf/distro/poky.conf

# RT scheduling support in userspace
DISTRO_FEATURES:append = " seccomp"

# Enable RT scheduler in kernel (handled by meta-realtime layer)
# Set high-resolution timers as default
KERNEL_FEATURES:append = " features/rt/rt.scc"

# Timezone
DEFAULT_TIMEZONE = "UTC"

# Compiler optimizations for Cortex-A76
DEFAULTTUNE ?= "cortexa76"

# No X11 / Wayland — headless RT system
DISTRO_FEATURES:remove = "x11 wayland vulkan"

# Package management format
PACKAGE_CLASSES = "package_ipk"

# Prefer systemd-networkd for networking (lighter than NetworkManager)
VIRTUAL-RUNTIME_net_manager = "connman"
```

## meta-drive-sim/conf/layer.conf
```bitbake
BBPATH .= ":${LAYERDIR}"

BBFILES += "${LAYERDIR}/recipes-*/*/*.bb \
            ${LAYERDIR}/recipes-*/*/*.bbappend"

BBFILE_COLLECTIONS += "drive-sim"
BBFILE_PATTERN_drive-sim = "^${LAYERDIR}/"
BBFILE_PRIORITY_drive-sim = "7"

LAYERDEPENDS_drive-sim = "core raspberrypi industrial-comm realtime"
LAYERSERIES_COMPAT_drive-sim = "scarthgap"
```

## meta-industrial-comm/conf/layer.conf
```bitbake
BBPATH .= ":${LAYERDIR}"

BBFILES += "${LAYERDIR}/recipes-*/*/*.bb \
            ${LAYERDIR}/recipes-*/*/*.bbappend"

BBFILE_COLLECTIONS += "industrial-comm"
BBFILE_PATTERN_industrial-comm = "^${LAYERDIR}/"
BBFILE_PRIORITY_industrial-comm = "6"

LAYERDEPENDS_industrial-comm = "core openembedded-layer networking-layer"
LAYERSERIES_COMPAT_industrial-comm = "scarthgap"
```

## meta-realtime/conf/layer.conf
```bitbake
BBPATH .= ":${LAYERDIR}"

BBFILES += "${LAYERDIR}/recipes-*/*/*.bb \
            ${LAYERDIR}/recipes-*/*/*.bbappend"

BBFILE_COLLECTIONS += "realtime"
BBFILE_PATTERN_realtime = "^${LAYERDIR}/"
BBFILE_PRIORITY_realtime = "6"

LAYERDEPENDS_realtime = "core raspberrypi"
LAYERSERIES_COMPAT_realtime = "scarthgap"
```
